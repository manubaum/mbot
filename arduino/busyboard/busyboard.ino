// generated by mBlock5 for mBot
// codes make you happy

#include <MeMCore.h>
#include <Arduino.h>
#include <Wire.h>
#include <SoftwareSerial.h>
#include "math.h"

/*
  Runder Schalter -> LEDs
  Kippschlater  -> Gsichtli im Display
  Ultraschall   -> Ventilator

  Hardware:
  Port1     RJ25 input
      Slot 1: runder Schalter
      Slot 2: Kippschalter
  Port2     RJ25 output
      Slot 1: LEDs
      Slot 2: -
  Port3     Display
  Port4     Fan
*/


//Port 1
MePort input(PORT_1);

//Port 2
MePort output(PORT_2);

//Port 3
MeLEDMatrix ledMatrix(PORT_3);
unsigned char drawBuffer[16];
unsigned char *drawTemp;

MeBuzzer buzzer;
MeLightSensor lightsensor(6);

// Port 4
MeDCMotor fan(PORT_4);
int16_t FAN_SPEED = 200;

boolean stateLED = false; // true -> on, false -> off
boolean stateDisplay = false; //true -> on, false -> off

char string_data[] = "Hallo Maro";
int move_times = sizeof(string_data)*6;

uint8_t Bitmap_Heart[16]=
{
 0x00,0x38,0x44,0x42,0x21,0x21,0x42,0x44,0x38,0x44,0x42,0x21,0x21,0x42,0x44,0x38,
};


void _delay(float seconds) {
  long endTime = millis() + seconds * 1000;
  while (millis() < endTime) _loop();
}

void setup() {

  // RJ25 adapter
  Serial.begin(9600);

  ledMatrix.setColorIndex(3);
  ledMatrix.setBrightness(3);

  pinMode(A7, INPUT);

  //signal readyness
  buzzer.tone(262, 0.25 * 1000);
  delay(20);

  //fan.run(FAN_SPEED);
  //fan.stop();
  //delay(500);


welcome();
}

void welcome(){


 for(int16_t i=14; i>-2-move_times; i--){
  
      ledMatrix.drawStr(i,7,string_data);
      delay(75);
 }
  
  ledMatrix.drawBitmap(0, 0, sizeof(Bitmap_Heart), Bitmap_Heart);
  delay(1000);
  
  return;    
}

void _loop() {
}

void loop() {
  _loop();


  //runder Schalter -> LEDs
  if (input.dRead1(INPUT_PULLUP) == stateLED)
  {
    //nothing to do
  }
  else if (input.dRead1(INPUT_PULLUP) && !stateLED) {
    output.dWrite1(HIGH);
    stateLED = true;
    fan.run(FAN_SPEED);
  }
  else {
    output.dWrite1(LOW);
    stateLED = false;
    fan.stop();
  }

  //Kippschalter -> Display
  if (input.dRead2(INPUT_PULLUP) == stateDisplay)
  {
    //nothing to do
  }
  else if (input.dRead2(INPUT_PULLUP) && !stateDisplay) {
    ledMatrix.showNum(M_PI);
    stateDisplay = true;
  }
  else {
    //clear display
    ledMatrix.clearScreen();
    //fan.stop();
    stateDisplay = false;
  }

  



  delay(10);//ms
}
